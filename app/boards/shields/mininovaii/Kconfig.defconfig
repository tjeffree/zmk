## app/boards/shields/mininovaii/Kconfig.defconfig
```kconfig
# Copyright (c) 2021 The ZMK Contributors
# SPDX-License-Identifier: MIT

if SHIELD_mininovaii

config ZMK_KEYBOARD_NAME
    default "mininovaii Keyboard"

endif
```
